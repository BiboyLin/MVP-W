## firmware/mcu/sdkconfig.defaults
```kconfig
# MCU (ESP32) default config
CONFIG_FREERTOS_HZ=1000
CONFIG_ESP_TASK_WDT_TIMEOUT_S=30
CONFIG_ESP_TASK_WDT=y
```

## firmware/s3/main/Kconfig.projbuild
```kconfig
menu "Wake Word Configuration"

config ENABLE_WAKE_WORD
    bool "Enable Wake Word Detection"
    default n
    depends on IDF_TARGET_ESP32S3 && SPIRAM
    help
        Enable offline wake word detection using ESP-SR.
        This requires PSRAM and is only supported on ESP32-S3.

        When enabled, the device can be triggered by saying the wake word
        instead of pressing the button.

choice WAKE_WORD_TYPE
    prompt "Wake Word Model"
    default WAKE_WORD_NIHAOXIAOZHI
    depends on ENABLE_WAKE_WORD

    config WAKE_WORD_NIHAOXIAOZHI
        bool "Ni Hao Xiao Zhi (你好小智)"
        help
            Use the built-in "你好小智" wake word model.

    config WAKE_WORD_CUSTOM
        bool "Custom Wake Word (Multinet)"
        help
            Use a custom wake word defined by pinyin.
endchoice

config CUSTOM_WAKE_WORD_PHRASE
    string "Custom Wake Word (Pinyin)"
    default "xiao wei xiao wei"
    depends on WAKE_WORD_CUSTOM
    help
        Custom wake word phrase in pinyin format.
        Example: "xiao wei xiao wei" for "小微小微"
        Words should be separated by spaces.

config CUSTOM_WAKE_WORD_THRESHOLD
    int "Custom Wake Word Threshold (%)"
    default 20
    range 1 99
    depends on WAKE_WORD_CUSTOM
    help
        Detection threshold for custom wake word.
        Lower values are more sensitive (more false positives).
        Higher values are less sensitive (may miss detections).
        Default 20 is a good balance.

config WAKE_WORD_DETECTION_TIMEOUT_MS
    int "Recording Timeout after Wake (ms)"
    default 10000
    depends on ENABLE_WAKE_WORD
    help
        Maximum recording duration after wake word detection.
        After this timeout, recording stops automatically.

endmenu
```

## firmware/s3/sdkconfig.defaults
```kconfig
# ESP32-S3 configuration
CONFIG_IDF_TARGET="esp32s3"

# Flash size (16MB for Watcher hardware)
CONFIG_ESPTOOLPY_FLASHSIZE_16MB=y
CONFIG_ESPTOOLPY_FLASHSIZE="16MB"

# Custom partition table (4MB app)
CONFIG_PARTITION_TABLE_CUSTOM=y
CONFIG_PARTITION_TABLE_CUSTOM_FILENAME="partitions.csv"

# PSRAM (required for audio buffers and LVGL)
CONFIG_ESP32S3_SPIRAM_SUPPORT=y
CONFIG_SPIRAM_MODE_OCT=y
CONFIG_SPIRAM_SPEED_40M=y
CONFIG_SPIRAM_MALLOC_ALWAYSINTERNAL_BITS=0

# WiFi
CONFIG_ESP_WIFI_ENABLED=y

# I2S (audio)
CONFIG_ESP_I2S_ENABLED=y

# FreeRTOS
CONFIG_FREERTOS_HZ=1000

# Log level
CONFIG_LOG_DEFAULT_LEVEL_INFO=y

# Watchdog
CONFIG_ESP_TASK_WDT_INIT=y
CONFIG_ESP_TASK_WDT_TIMEOUT_S=30

# SPI
CONFIG_SPI_MASTER=y

# LCD
CONFIG_LCD_ENABLE_DEBUG_LOG=n

# LVGL (from remote registry)
CONFIG_LV_COLOR_16_SWAP=y
CONFIG_LV_MEM_CUSTOM=0

# LVGL CJK font support for Chinese characters
CONFIG_LV_FONT_SIMSUN_16_CJK=y
CONFIG_LV_USE_FS_STDIO=y
CONFIG_LV_FS_STDIO_LETTER=83
```
